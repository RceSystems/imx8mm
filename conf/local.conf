## conf/local.conf
```bitbake
MACHINE ??= 'imx8mm-var-dart'
DISTRO ?= 'fslc-xwayland'
PACKAGE_CLASSES ?= 'package_rpm'
IMAGE_INSTALL_append = " tcf-agent perl lmsensors-sensors libpgiod-dev gpiod mtd-utils mtd-utils-tests"
TOOLCHAIN_TARGET_TASK_append = " kernel-devsrc"
TOOLCHAIN_HOST_TASK_append += " nativesdk-cmake-dev"
EXTRA_IMAGE_FEATURES ?= "debug-tweaks tools-debug eclipse-debug"
USER_CLASSES ?= "buildstats image-mklibs image-prelink"
PATCHRESOLVE = "noop"
BB_DISKMON_DIRS ??= "\
    STOPTASKS,${TMPDIR},1G,100K \
    STOPTASKS,${DL_DIR},1G,100K \
    STOPTASKS,${SSTATE_DIR},1G,100K \
    STOPTASKS,/tmp,100M,100K \
    ABORT,${TMPDIR},100M,1K \
    ABORT,${DL_DIR},100M,1K \
    ABORT,${SSTATE_DIR},100M,1K \
    ABORT,/tmp,10M,1K"
PACKAGECONFIG_append_pn-qemu-system-native = " sdl"
CONF_VERSION = "1"

ACCEPT_FSL_EULA = "1"

KERNEL_DEVICETREE_append = " freescale/imx8mm-resptech.dtb"

MIRROR_SERVER = "file:///dockerVol/nginx/"

# ########################################################
# Setup for developer
# ########################################################
#BB_FETCH_PREMIRRORONLY = "1"
SOURCE_MIRROR_URL = "${MIRROR_SERVER}/downloads"
UNINATIVE_URL = "${SOURCE_MIRROR_URL}"
INHERIT += "own-mirrors"
SSTATE_MIRRORS ?= "file://.* ${MIRROR_SERVER}/sstate-cache/PATH"

# ########################################################
# Setup for build server creation
# ########################################################
#BB_GENERATE_MIRROR_TARBALLS = "1"
#To populate the source mirror start a normal server build or run: bitbake --runall=fetch fsl-image-gui

# ########################################################
# Setup for both
# ########################################################
DL_DIR = "/dockerVol/yocto/downloads/"
SSTATE_DIR = "/dockerVol/yocto/sstate-cache/"
```
